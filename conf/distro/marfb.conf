## conf/distro/marfb.conf
```bitbake
DISTRO = "marfb"
DISTRO_NAME = "MAR Autonomous Rover Fastboot Linux System (MARS by University of Southampton)"
DISTRO_VERSION = "0.0.7a"

MAINTAINER = "Qiyang Sun <qs2g22@soton.ac.uk>"

LOCALCONF_VERSION = "1"

PACKAGE_CLASSES ?= "package_deb"

DISTRO_FEATURES = "acl ipv4 kbd multiarch pci polkit usbhost usrmerge vfat wifi xattr zeroconf"

EXTRA_RDEPENDS = "packagegroup-core-boot"
EXTRA_RRECOMMENDS = "kernel-module-af-packet"

# use sysvinit instead of systemd
INIT_MANAGER ?= "sysvinit"

# https://meta-raspberrypi.readthedocs.io/en/latest/extra-build-config.html

# enable uart
ENABLE_UART = "1"

# disable gpu splash screen
DISABLE_SPLASH = "1"

# do not delay to wait for sd card ready
BOOT_DELAY = "0"
BOOT_DELAY_MS = "0"

# enable support for the video camera (Linux 3.12.4+ required)
VIDEO_CAMERA = "1"

DISABLE_RPI_BOOT_LOGO = "1"

#ENABLE_DWC2_PERIPHERAL = "1"

DISABLE_VC4GRAPHICS = "1"

#RPI_KERNEL_DEVICETREE_OVERLAYS:append = " overlays/uart0.dtbo"
RPI_KERNEL_DEVICETREE_OVERLAYS:append = " overlays/uart1.dtbo"

RASPBERRYPI_CAMERA_V2 = "1"
RASPBERRYPI_CAMERA_V3 = "1"

RPI_KERNEL_DEVICETREE_OVERLAYS:append = " overlays/ov5647.dtbo"
```

## conf/layer.conf
```bitbake
# We have a conf and classes directory, add to BBPATH
BBPATH .= ":${LAYERDIR}"

# We have recipes-* directories, add to BBFILES
BBFILES += "${LAYERDIR}/recipes-*/*/*.bb \
            ${LAYERDIR}/recipes-*/*/*.bbappend"

BBFILE_COLLECTIONS += "meta-marfb"
BBFILE_PATTERN_meta-marfb = "^${LAYERDIR}/"
BBFILE_PRIORITY_meta-marfb = "9"

LAYERDEPENDS_meta-marfb = "core"
LAYERSERIES_COMPAT_meta-marfb = "scarthgap"

IMAGE_INSTALL += " mar-image-minimal"
```
